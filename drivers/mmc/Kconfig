## drivers/mmc/Kconfig
```kconfig
#
# MMC subsystem configuration
#

menuconfig MMC
	tristate "MMC/SD/SDIO card support"
	depends on HAS_IOMEM
	help
	  This selects MultiMediaCard, Secure Digital and Secure
	  Digital I/O support.

	  If you want MMC/SD/SDIO support, you should say Y here and
	  also to your specific host controller driver.

config MMC_DEBUG
	bool "MMC debugging"
	depends on MMC != n
	help
	  This is an option for use by developers; most people should
	  say N here.  This enables MMC core and driver debugging.

config MMC_PERF_PROFILING
	bool "MMC performance profiling"
	depends on MMC != n
	default n
	help
	  If you say Y here, support will be added for collecting
	  performance numbers at the MMC Queue and Host layers.

config SHSD_DRIVER
	bool "SHARP SD driver"
	default y

config SDIO_CUST_SH
	bool "SHARP SDIO driver customized"
	default y

config MMC_CUST_SH
	bool "SHARP MMC driver customized"
	depends on MMC && MMC_MSM_SDC2_SUPPORT
	default n

config RELIABLE_WRITE_EMMC_CUST_SH
	bool "SHARP MMC reliable write customized"
	depends on MMC && MMC_CUST_SH
	default n

config RW_PROTECT_EMMC_CUST_SH
	bool "SHARP MMC read/write protect customized"
	depends on MMC && MMC_CUST_SH
	default n

config ERR_RETRY_EMMC_CUST_SH
	bool "SHARP MMC error retry customized"
	depends on MMC && MMC_CUST_SH
	default n

config ACCESS_OPTIMIZE_EMMC_CUST_SH
	bool "SHARP MMC access optimization customized"
	depends on MMC && MMC_CUST_SH
	default n

config TIMEOUTCTRL_EMMC_CUST_SH
	bool "SHARP MMC timeout control customized"
	depends on MMC && MMC_CUST_SH
	default n

config IDLECTRL_EMMC_CUST_SH
	bool "SHARP MMC idle control customized"
	depends on MMC && MMC_CUST_SH
	default n

if MMC

source "drivers/mmc/core/Kconfig"

source "drivers/mmc/card/Kconfig"

source "drivers/mmc/host/Kconfig"

endif # MMC
```

## drivers/sharp/proximity/Kconfig
```kconfig
#
# Proximity device configuration
#
# drivers/sharp/proximity/Kconfig

menu "Proximity Configuration"

config SENSORS_PROXIMITY
	tristate "Proximity Sensor Driver"
	depends on I2C

config PROXIMITY_IRQ_SETTING
	int "PROXIMITY IRQ Setting"
	depends on SENSORS_PROXIMITY
	range 0 3
	default "0"

config PROXIMITY_SENSITIVITY_SETTING
	int "PROXIMITY Sensitivity Setting"
	depends on SENSORS_PROXIMITY
	range 0 2
	default "0"

config PROXIMITY_POWER_SUPPLY_SETTING
	int "PROXIMITY Power Supply Setting"
	depends on SENSORS_PROXIMITY
	range 0 1
	default "0"

config PROXIMITY_WAKESW
	bool "Proximity WAKESW"
	depends on SENSORS_PROXIMITY
	default n

endmenu
```

## drivers/sharp/shmds/ami603/Kconfig
```kconfig
menu "AMI603 MDS DRIVER"

config SENSORS_AMI603
	tristate "AMI603 sensor"

config SENSORS_AMI603_FLIP
	tristate "AMI603 FLIP"

endmenu
```

## drivers/sharp/wifi/Kconfig
```kconfig
# drivers/sharp/wifi/Kconfig

menu "Wi-Fi Configuration"

config WIFIPM
	bool "WLAN Power Management Support"
	default y
	help
	  Power management implementation for WLAN Functionality.

config SHWLAN_BCM4329_1
	bool "BCM4329 WiFi device Support"
	default y
	help
	  Enable BCM4329 WiFi device driver.

config SHWLAN_BCM4330_1
	bool "BCM4330 WiFi device Support"
	default n
	help
	  Enable BCM4330 WiFi device driver.
endmenu
```
